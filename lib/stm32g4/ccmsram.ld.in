/*
 * Mark functions with CCMSRAM (lib/stm32/Inc/sys.hpp) and call System::init_ccmsram() before running
 */
MEMORY
{
  CCMSRAM (xrw) : ORIGIN = 0x10000000, LENGTH = @MX_CCMSRAM_SIZE@
}

SECTIONS
{
  .ccmsram : AT(LOADADDR(.data) + SIZEOF(.data) + SIZEOF(.tdata) + 16)
  {
    . = ALIGN(4);
    _sccmsram = .;
    *(.ccmsram)
    *(.ccmsram*)
    . = ALIGN(4);
    _eccmsram = .;
  } >CCMSRAM
  _siccmsram = LOADADDR(.ccmsram);
}

ASSERT(_eccmsram - ORIGIN(CCMSRAM) + _Min_Stack_Size <= LENGTH(CCMSRAM), "CCM SRAM code overlaps the stack")
ASSERT(_ebss <= @MX_CCMSRAM_ALIAS@, ".data/.bss reach the CCM SRAM alias")
ASSERT(_siccmsram + SIZEOF(.ccmsram) <= ORIGIN(FLASH) + LENGTH(FLASH), "CCM SRAM code image overflows FLASH")
